/*
 * Copyright (c) 2020 The ZMK Contributors
 *
 * SPDX-License-Identifier: MIT
 */

#include <behaviors.dtsi>

#define LEFT_HAND_KEYS 0 1 2 3 4 12 13 14 15 16 17 24 25 26 27 28 29 36 37 38
#define RIGHT_HAND_KEYS 6 7 8 9 10 11 18 19 20 21 22 23 30 31 32 33 34 35 39 40 41

/ {
    behaviors {
        hrm_l: homerow_mod_left {
            compatible = "zmk,behavior-hold-tap";
            display-name = "HRM_L";
            #binding-cells = <2>;
            flavor = "tap-preferred";
            tapping-term-ms = <250>;
            require-prior-idle-ms = <200>;
            bindings = <&kp>, <&kp>;
            hold-trigger-key-positions = <RIGHT_HAND_KEYS>;
            hold-trigger-on-release;
        };

        hrm_r: homerow_mod_right {
            compatible = "zmk,behavior-hold-tap";
            display-name = "HRM_R";
            #binding-cells = <2>;
            flavor = "tap-preferred";
            tapping-term-ms = <250>;
            require-prior-idle-ms = <200>;
            bindings = <&kp>, <&kp>;
            hold-trigger-key-positions = <LEFT_HAND_KEYS>;
            hold-trigger-on-release;
        };

        //add your custom behaviors here
    };
};
