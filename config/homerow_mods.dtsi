// Copyright 2024 TBK Mini ZMK Config
// Home Row Mods Implementation inspired by Miryoku

/ {
  behaviors {
    // Miryoku-style home row mod behavior
    // Takes 2 parameters: MOD and TAP
    hrm: homerow_mod {
      compatible = "zmk,behavior-hold-tap";
      label = "HRM";
      #binding-cells = <2>;
      flavor = "tap-preferred";
      tapping-term-ms = <200>;
      bindings = <&kp>, <&kp>;
    };
  };
};
